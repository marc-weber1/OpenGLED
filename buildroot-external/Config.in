## buildroot-external/package/open-gled/Config.in
```kconfig
config BR2_PACKAGE_OPEN_GLED
	bool "open-gled"
	depends on BR2_INSTALL_LIBSTDCPP
	depends on BR2_TOOLCHAIN_HAS_THREADS
	select BR2_PACKAGE_ALSA_LIB
	help
	  OpenGLED: renders GLSL fragment shaders headlessly with the
	  VC4 GPU and drives a WS281x LED strip, with audio-reactive
	  input from an ALSA capture device.

	  Requires mesa3d with the vc4 gallium driver, OpenGL ES and
	  EGL enabled (done in configs/opengled.fragment).
```
